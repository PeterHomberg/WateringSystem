## firmware/sdkconfig.defaults
```kconfig
# --- BLE -----------------------------------------------------------------------
# Legacy advertising required — iOS cannot see extended (BT5) advertisements.
CONFIG_BT_ENABLED=y
CONFIG_BT_BLE_ENABLED=y
CONFIG_BT_NIMBLE_ENABLED=y
CONFIG_BT_NIMBLE_EXT_ADV=n
CONFIG_BT_NIMBLE_MAX_CONNECTIONS=3

# --- WiFi ----------------------------------------------------------------------
CONFIG_ESP_WIFI_ENABLED=y
CONFIG_ESP_WIFI_STATIC_RX_BUFFER_NUM=4
CONFIG_ESP_WIFI_DYNAMIC_RX_BUFFER_NUM=8

# --- lwIP — larger stack required by AsyncWebServer ----------------------------
CONFIG_LWIP_TCPIP_TASK_STACK_SIZE=4096

# --- USB serial (ESP32-S3 specific) --------------------------------------------
# The S3 devKitC-1 has no separate UART bridge chip.
# Routes console to built-in USB Serial/JTAG so USB-C works for
# both flashing and the serial monitor.
CONFIG_ESP_CONSOLE_USB_SERIAL_JTAG=y

# --- PSRAM — OPI mode for N16R8 variant ----------------------------------------
CONFIG_SPIRAM_MODE_OCT=y
CONFIG_SPIRAM_SPEED_80M=y
```
